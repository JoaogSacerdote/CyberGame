## sdkconfig.defaults
```kconfig
# Defaults do projeto CyberGame.
# Sao aplicados quando sdkconfig nao existe (build limpo) ou quando algum
# valor aqui ainda nao esta presente no sdkconfig gerado.
#
# Para forcar reaplicacao apos editar:
#   idf.py fullclean && idf.py build
# Ou alternativamente:
#   idf.py menuconfig  (e salvar)

# --- TinyUSB ---
# Habilita classe CDC (Communication Device Class) — necessaria pelo
# components/recovery/. Sem isso, tusb_cdc_acm.h aborta o build com
# "TinyUSB CDC driver must be enabled in menuconfig".
CONFIG_TINYUSB_CDC_ENABLED=y

# --- PSRAM Octal 40MHz ---
# ESP32-S3 N16R8: 8MB *Octal* PSRAM (o "R8" do part number = Octal 8MB).
# Necessario para os sprites e framebuffer (recepcao 480x320 RGB565 =
# ~307KB) — nao cabe na DRAM interna.
#
# HISTORICO:
#   - Octal@80MHz: boot loop na placa nova (2026-05). Sinal nao aguentou.
#   - Quad@40MHz: chip nao detectado (2026-06-05). Quad nao funciona em
#     chip Octal-only — modo precisa casar com o chip; so o clock pode
#     baixar.
#   - Octal@40MHz: alvo atual. Mesmo modo do chip, clock reduzido.
CONFIG_SPIRAM=y
CONFIG_SPIRAM_MODE_OCT=y
CONFIG_SPIRAM_SPEED_40M=y
CONFIG_SPIRAM_USE_MALLOC=y

# --- Flash 16MB (ESP32-S3 N16R8) ---
CONFIG_ESPTOOLPY_FLASHSIZE_16MB=y

# --- Particao customizada (factory 4M ao inves de 1M) ---
# Necessario porque os assets de UI (PNGs convertidos para arrays C em
# components/assets/generated/) somam ~2.1 MB e estouram a particao
# factory padrao de 1MB. Layout completo em partitions.csv.
CONFIG_PARTITION_TABLE_CUSTOM=y
CONFIG_PARTITION_TABLE_CUSTOM_FILENAME="partitions.csv"
CONFIG_PARTITION_TABLE_FILENAME="partitions.csv"

# --- LVGL 9.3 ---
# RGB565 para casar com display_hal (DISPLAY_HAL_BYTES_PER_PIXEL = 2).
CONFIG_LV_COLOR_DEPTH_16=y
# LVGL com locking via FreeRTOS mutex (lv_lock/lv_unlock thread-safe).
# ATENCAO: o simbolo correto e CONFIG_LV_OS_FREERTOS (choice LV_USE_OS do
# Kconfig do LVGL). O nome antigo CONFIG_LV_USE_OS_FREERTOS nao existe e era
# silenciosamente ignorado -> caia em LV_OS_NONE -> lv_lock() virava no-op.
CONFIG_LV_OS_FREERTOS=y
# Sem padding entre linhas no buffer parcial: display_hal_draw_bitmap
# assume pixels densamente empacotados. Stride > width corrompe shapes
# (cada letra "deslocada" vira glifos alienigenas).
CONFIG_LV_DRAW_BUF_STRIDE_ALIGN=1
```
